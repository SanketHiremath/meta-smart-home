## conf/layer.conf
```bitbake
# We have a conf and classes directory, add to BBPATH
BBPATH .= ":${LAYERDIR}"

# We have recipes-* directories, add to BBFILES
BBFILES += "${LAYERDIR}/recipes-*/*/*.bb \
            ${LAYERDIR}/recipes-*/*/*.bbappend"

BBFILE_COLLECTIONS += "smart-home"
BBFILE_PATTERN_smart-home = "^${LAYERDIR}/"
BBFILE_PRIORITY_smart-home = "10"

LAYERDEPENDS_smart-home = "core stm-st-stm32mp st-openstlinux"
LAYERSERIES_COMPAT_smart-home = "scarthgap"
```
